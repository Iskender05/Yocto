## Yocto/meta-hello/conf/layer.conf
```bitbake
# We have a conf and classes directory, add to BBPATH
BBPATH .= ":${LAYERDIR}"

# We have recipes-* directories, add to BBFILES
BBFILES += "${LAYERDIR}/recipes-*/*/*.bb \
            ${LAYERDIR}/recipes-*/*/*.bbappend"

BBFILE_COLLECTIONS += "meta-hello"
BBFILE_PATTERN_meta-hello = "^${LAYERDIR}/"
BBFILE_PRIORITY_meta-hello = "6"

LAYERDEPENDS_meta-hello = "core"
LAYERSERIES_COMPAT_meta-hello = "kirkstone"
```
